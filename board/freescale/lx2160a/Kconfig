## board/freescale/lx2160a/Kconfig
```kconfig
if ARCH_LX2160A

config SYS_BOARD
	default "lx2160a"

config SYS_VENDOR
	default "freescale"

config SYS_SOC
	default "fsl-layerscape"

config SYS_CONFIG_NAME
	default "lx2160acex7" if TARGET_LX2160ACEX7
	default "lx2160ardb" if TARGET_LX2160ARDB
	default "lx2160aqds" if TARGET_LX2160AQDS

source "board/freescale/common/Kconfig"
endif
```
